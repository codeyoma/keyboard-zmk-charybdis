## boards/shields/charybdis/Kconfig.shield
```kconfig
config SHIELD_CHARYBDIS_DONGLE
	def_bool $(shields_list_contains,charybdis_dongle)

config SHIELD_CHARYBDIS_LEFT
	def_bool $(shields_list_contains,charybdis_left)

config SHIELD_CHARYBDIS_RIGHT
	def_bool $(shields_list_contains,charybdis_right)

config SHIELD_CHARYBDIS_RIGHT_CENTRAL
	def_bool $(shields_list_contains,charybdis_right_central)
```

## config/west.yml
```yaml
manifest:
  remotes:
    - name: zmkfirmware
      url-base: https://github.com/zmkfirmware
    - name: urob
      url-base: https://github.com/urob

    - name: badjeff
      url-base: https://github.com/badjeff
    # - name: Cyboard-DigitalTailor
    #   url-base: https://github.com/Cyboard-DigitalTailor

    - name: englmaxi
      url-base: https://github.com/englmaxi
    - name: carrefinho
      url-base: https://github.com/carrefinho
    - name: not-in-stock
      url-base: https://github.com/not-in-stock
    
    - name: mctechnology17
      url-base: https://github.com/mctechnology17

  projects:
    - name: zmk
      remote: zmkfirmware
      revision: v0.3-branch
      import: app/west.yml

    - name: zmk-pmw3610-driver
      remote: badjeff
      revision: zmk-0.3
    # - name: zmk-pmw3610-driver
    #   remote: Cyboard-DigitalTailor
    #   revision: startup_optimization

    - name: zmk-helpers
      remote: urob
      revision: main
    - name: zmk-dongle-display
      remote: englmaxi
      revision: v0.3

    # - name: prospector-zmk-module
    #   remote: not-in-stock
    #   revision: main

    - name: zmk-config
      remote: mctechnology17
      revision: main

    - name: zmk-dongle-display-view
      remote: mctechnology17
      revision: main

    - name: zmk-nice-oled
      remote: mctechnology17
      revision: main


  self:
    path: config
```
