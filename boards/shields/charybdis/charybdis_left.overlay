#include "charybdis.dtsi"

&kscan0 {
	col-gpios
		= <&gpio0 2 (GPIO_ACTIVE_HIGH | GPIO_PULL_DOWN)>
		, <&gpio0 29 (GPIO_ACTIVE_HIGH | GPIO_PULL_DOWN)>
		, <&gpio0 9 (GPIO_ACTIVE_HIGH | GPIO_PULL_DOWN)>
		, <&gpio1 0  (GPIO_ACTIVE_HIGH | GPIO_PULL_DOWN)>
		, <&gpio0 11 (GPIO_ACTIVE_HIGH | GPIO_PULL_DOWN)>

		;
};

// INFO: uncomment for dual trackball
// NOTE: Dual trackball uses right-side PCB pattern with swapped switches.
// You MUST also select the swapped transform by adding this to your overlay:
//
// &default_phy_layout {
//     transform = <&five_column_transform_swapped>;
// };
//
// Or add to the chosen node:
// chosen {
//     zmk,matrix-transform = &five_column_transform_swapped;
// };
//
// &spi0 {
//     status = "okay";
// };
//
// &trackball_split {
//     status = "disabled";
// };
//
// &trackball_left_split {
//     device = <&trackball>;
// };
