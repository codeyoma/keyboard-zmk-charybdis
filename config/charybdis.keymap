#include <behaviors.dtsi>

#include <dt-bindings/zmk/bt.h>
#include <dt-bindings/zmk/keys.h>
#include <dt-bindings/zmk/pointing.h>
#include <dt-bindings/zmk/mouse.h>

#include <dt-bindings/zmk/ext_power.h>
#include <dt-bindings/zmk/outputs.h>

#include "zmk-helpers/helper.h"
#define NONE	0
#define DEFAULT	0
#define COLEMAK	1
#define LOWER	2
#define RAISE	3
#define ADJUST	4
#define MOUSE   5
#define SCROLL  6
#define SNIPE   7
#define TEST	8

#include "zmk-helpers/key-labels/34.h"                                      // key-position labels

#define KEYS_L LT0 LT1 LT2 LT3 LT4 LM0 LM1 LM2 LM3 LM4 LB0 LB1 LB2 LB3 LB4  // left-hand keys
#define KEYS_R RT0 RT1 RT2 RT3 RT4 RM0 RM1 RM2 RM3 RM4 RB0 RB1 RB2 RB3 RB4  // right-hand keys
#define KEYS_T                 LH1 LH0 RH0 RH1                              // thumb keys

#define ________	&trans
#define XXXXXXXX 	&none

#define FOCUS_NEXT	&kp LC(F4)
#define FOCUS_MENU	&kp LC(F2)
#define _MOVE_LEFT	&kp LG(LBKT)
#define _MOVE_RIGHT	&kp LG(RBKT)

#define HM_LP	&hm LCTRL
#define HM_LR	&hm LGUI
#define HM_LM	&hm_alt LALT
#define HM_LI	&hm LSHFT

#define HM_RI	&hm RSHFT
#define HM_RM	&hm_alt RALT
#define HM_RR	&hm LGUI
#define HM_RP	&hm LCTRL

#define TAPPING_TERM_MS		220	// Charybdis QMK TAPPING_TERM
#define LT_TAPPING_TERM_MS	220	// TAPPING_TERM
#define TD_TAPPING_TERM_MS	220	// TAPPING_TERM
#define QUICK_TAP_MS		140	// QUICK_TAP_TERM
#define GLOBAL_QUICK_TAP_MS	150
#define IDLE_MS				150	// FLOW_TAP_TERM
#define CB_MINIMUM_SPEED	50	// COMBO_TERM (QMK default)
#define	DEFAULT_SPEED		50

#define PARAM_ZERO	0
#define PARAM_ONE	1
#define PARAM_TWO	2

#include "custom/behaviors.dtsi"
#include "custom/combos.dtsi"
#include "custom/macros.dtsi"

#include "layer/L1-qwerty.dtsi"
#include "layer/L1-colemak.dtsi"
#include "layer/L2-lower.dtsi"
#include "layer/L3-raise.dtsi"
#include "layer/L4-adjust.dtsi"
#include "layer/L5-mouse.dtsi"
#include "layer/L6-scroll.dtsi"
#include "layer/L7-snipe.dtsi"
#include "layer/L8-test.dtsi"

/ {
	conditional_layers {
		compatible = "zmk,conditional-layers";
		tri_layer   {
			if-layers = <LOWER RAISE>;
			then-layer = <ADJUST>;
		};
	};
};